## CMakeLists.txt
```
# SPDX-License-Identifier: Apache-2.0

cmake_minimum_required(VERSION 3.20.0)
find_package(Zephyr REQUIRED HINTS $ENV{ZEPHYR_BASE})
project(zpp_rtos_test_mutex)

FILE(GLOB app_sources src/*.cpp)
target_sources(app PRIVATE ${app_sources})
```

## prj.conf
```kconfig
CONFIG_ZTEST=y

# C++ support
CONFIG_CPP=y
CONFIG_REQUIRES_FULL_LIBCPP=y
CONFIG_STD_CPP17=y

# increase the stack size of the main thread
CONFIG_MAIN_STACK_SIZE=4096
# configure the stack size of the threads created with zpp_lib
CONFIG_ZPP_THREAD_STACK_SIZE=2048

# we use zpp_lib
CONFIG_USE_ZPP_LIB=y

# logging
CONFIG_LOG=y
CONFIG_ZPP_RTOS_LOG_LEVEL_DBG=y
CONFIG_ZPP_DRIVERS_LOG_LEVEL_DBG=y

# HW
CONFIG_GPIO=y

# RTT
CONFIG_STDOUT_CONSOLE=y
# enable to use thread names
CONFIG_THREAD_NAME=y

# enable ASSERT
CONFIG_ASSERT=y

# disable debugging information
CONFIG_DEBUG_OPTIMIZATIONS=n
```

## src/main.cpp
```c
// Copyright 2025 Haute école d'ingénierie et d'architecture de Fribourg
//
// Licensed under the Apache License, Version 2.0 (the "License");
// you may not use this file except in compliance with the License.
// You may obtain a copy of the License at
//
//     http://www.apache.org/licenses/LICENSE-2.0
//
// Unless required by applicable law or agreed to in writing, software
// distributed under the License is distributed on an "AS IS" BASIS,
// WITHOUT WARRANTIES OR CONDITIONS OF ANY KIND, either express or implied.
// See the License for the specific language governing permissions and
// limitations under the License.

/****************************************************************************
 * @file test_mutex.cpp
 * @author Serge Ayer <serge.ayer@hefr.ch>
 *
 * @brief Test program for zpp_lib Mutex class
 *
 * @date 2025-08-31
 * @version 1.0.0
 ***************************************************************************/

// zpp_rtos
#include "zpp_include/mutex.hpp"
#include "zpp_include/thread.hpp"
#include "zpp_include/zpp_assert.hpp"
#include "zpp_include/zpp_test.hpp"

// test cases
ZPP_ZTEST_USER(zpp_mutex, test_mutex_lock_unlock) {
  zpp_lib::Mutex mutex;

  // TESTPOINT: try to lock and unlock mutex several times
  auto bool_ret = mutex.try_lock();
  zpp_zassert_true(!bool_ret.has_error());
  zpp_zassert_true(bool_ret);
  zpp_zassert_true(mutex.unlock());
  bool_ret = mutex.try_lock();
  zpp_zassert_true(!bool_ret.has_error());
  zpp_zassert_true(bool_ret);
  zpp_zassert_true(mutex.unlock());

  // TESTPOINT: try to lock and unlock mutex in another thread
  static constexpr auto kThreadName = "test_mutex_thread";
#if CONFIG_USER_SPACE
  zpp_lib::Thread thread(zpp_lib::PreemptableThreadPriority::Normal, kThreadName, true);
#else   // CONFIG_USER_SPACE
  zpp_lib::Thread thread(zpp_lib::PreemptableThreadPriority::PriorityNormal, kThreadName);
#endif  // CONFIG_USER_SPACE
  auto ret = thread.start([&mutex]() {
    auto bool_ret = mutex.try_lock();
    zpp_zassert_true(!bool_ret.has_error());
    zpp_zassert_true(bool_ret);
    zpp_zassert_true(mutex.unlock());
  });
  zpp_zassert_true(ret);
  zpp_zassert_true(thread.join());
}

ZPP_ZTEST_SUITE(zpp_mutex, nullptr, nullptr, nullptr, nullptr, nullptr);
```

## src/test_mutex.cpp
```c
// Copyright 2025 Haute école d'ingénierie et d'architecture de Fribourg
//
// Licensed under the Apache License, Version 2.0 (the "License");
// you may not use this file except in compliance with the License.
// You may obtain a copy of the License at
//
//     http://www.apache.org/licenses/LICENSE-2.0
//
// Unless required by applicable law or agreed to in writing, software
// distributed under the License is distributed on an "AS IS" BASIS,
// WITHOUT WARRANTIES OR CONDITIONS OF ANY KIND, either express or implied.
// See the License for the specific language governing permissions and
// limitations under the License.

/****************************************************************************
 * @file test_mutex.cpp
 * @author Serge Ayer <serge.ayer@hefr.ch>
 *
 * @brief Test program for zpp_lib Mutex class
 *
 * @date 2025-08-31
 * @version 1.0.0
 ***************************************************************************/

#include <zephyr/ztest.h>

// zpp_rtos
#include "zpp_include/mutex.hpp"
#include "zpp_include/thread.hpp"

// test cases
ZTEST_USER(zpp_mutex, test_mutex_lock_unlock) {
  zpp_lib::Mutex mutex;

  // TESTPOINT: try to lock and unlock mutex several times
  auto boolRet = mutex.try_lock();
  zassert_true(!boolRet.has_error());
  zassert_true(boolRet);
  zassert_true(mutex.unlock());
  boolRet = mutex.try_lock();
  zassert_true(!boolRet.has_error());
  zassert_true(boolRet);
  zassert_true(mutex.unlock());

  // TESTPOINT: try to lock and unlock mutex in another thread
  zpp_lib::Thread thread;
  auto ret = thread.start([&mutex]() {
    auto boolRet = mutex.try_lock();
    zassert_true(!boolRet.has_error());
    zassert_true(boolRet);
    zassert_true(mutex.unlock());
  });
  zassert_true(ret);
  zassert_true(thread.join());
}

ZTEST_SUITE(zpp_mutex, nullptr, nullptr, nullptr, nullptr, nullptr);
```
