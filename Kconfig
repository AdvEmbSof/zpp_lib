## Kconfig
```kconfig
config ZPP_LIB
	bool "Support for zpp library"
	default n
	help
	  This option enables the 'zpp rtos' library

config THREAD_STACK_SIZE
	int "Default user thread stack size"
	depends on ZPP_LIB
	default 1024
	help
	  This option allows to specify the default stack size to be used for user threads
  
module = ZPP_RTOS
module-str = ZPP_RTOS
source "subsys/logging/Kconfig.template.log_config"

module = ZPP_DRIVERS
module-str = ZPP_DRIVERS
source "subsys/logging/Kconfig.template.log_config"
```

## manifest-repo/west.yml
```yaml
manifest:
  # lowest version of the manifest file schema that can parse this file’s data
  version: 0.13

  projects:
    - name: zephyr
      revision: v4.4.0
      url: https://github.com/zephyrproject-rtos/zephyr
      import:
        path-prefix: deps
        file: west.yml # not strictly needed since it is the value by default
        name-allowlist:
          - cmsis_6
          - hal_nordic
          - hal_stm32
          - hal_st
    - name: zpp_lib
      url: https://github.com/AdvEmbSof/zpp_lib.git
      revision: main
      path: deps/zpp_lib
```

## zephyr/Kconfig
```kconfig
config USE_ZPP_LIB
	bool "Support for zpp library"
	default n
	select THREAD_NAME
	select EVENTS
  select CONFIG_APPLICATION_DEFINED_SYSCALL if USERSPACE
	help
	  This option enables the 'zpp' library

config ZPP_THREAD_POOL_SIZE
  int "Number of statically pre-allocated threads"
	depends on USE_ZPP_LIB
	default 2
	range 0 10
	help		
		This allows to pre-allocate a default number of thread stacks
		that are required for the use of zpp_lib (zpp_lib::Thread)

config ZPP_THREAD_STACK_SIZE
	int "Default zpp thread stack size"
	depends on USE_ZPP_LIB
	default 1024
	help
	  This option allows to specify the default stack size to be used for user threads

config ZPP_EVENT_POOL_SIZE
  int "Number of statically pre-allocated k_event object"
	depends on USE_ZPP_LIB && USERSPACE
	default 2
	range 0 10
	help 
	  This allows to pre-allocate a default number of k_event kernel objects
		that must allocated in static memory when user mode is activated
		The number of pre-allocated k_event kernel objects will be ZPP_THREAD_POOL_SIZE + ZPP_EVENT_POOL_SIZE

config ZPP_MUTEX_POOL_SIZE
  int "Number of statically pre-allocated k_mutx object"
	depends on USE_ZPP_LIB && USERSPACE
	default 6
	range 0 10
	help 
	  This allows to pre-allocate a default number of k_mutex kernel objects
		that must allocated in static memory when user mode is activated
		The number of pre-allocated k_mutex kernel objects will be ZPP_THREAD_POOL_SIZE + ZPP_MUTEX_POOL_SIZE

module = ZPP_RTOS
module-str = ZPP_RTOS
rsource "$(ZEPHYR_BASE)/subsys/logging/Kconfig.template.log_config"

module = ZPP_DRIVERS
module-str = ZPP_DRIVERS
rsource "$(ZEPHYR_BASE)/subsys/logging/Kconfig.template.log_config"
```

## zpp_drivers/tests/interrupt_in/testcase.yaml
```yaml
tests:
  zpp_lib.zpp_drivers.interrupt_in:
    tags:
      - cpp
    timeout: 120
    extra_conf_files: 
      - ../../../configs/prj.conf
      - ../../../configs/prj_log.conf
      - ../../../configs/prj_test.conf
      - ../../../configs/prj_gpio.conf
    extra_args: 
      - platform:qemu_x86/atom:CONFIG_INTERRUPT_IN_EMUL=y
      - platform:qemu_x86/atom:CONFIG_SYS_CLOCK_TICKS_PER_SEC=5000
```

## zpp_rtos/tests/boards/native_sim.conf
```kconfig
CONFIG_ZTEST=y

CONFIG_ZPP_LIB=y

CONFIG_ASSERT=y
CONFIG_ASSERT_LEVEL=2

CONFIG_CPP=y
CONFIG_REQUIRES_FULL_LIBCPP=y
CONFIG_STD_CPP17=y

CONFIG_LOG=y
CONFIG_ZPP_RTOS_LOG_LEVEL_DBG=y
CONFIG_ZPP_DRIVERS_LOG_LEVEL_DBG=y

CONFIG_USERSPACE=n
CONFIG_INIT_STACKS=y
CONFIG_THREAD_STACK_INFO=y
CONFIG_DYNAMIC_THREAD=y
CONFIG_DYNAMIC_THREAD_POOL_SIZE=4
CONFIG_DYNAMIC_THREAD_ALLOC=y
CONFIG_MAIN_STACK_SIZE=2048

CONFIG_ZTEST_STACK_SIZE=4096
```

## zpp_rtos/tests/mutex/testcase.yaml
```yaml
tests:
  zpp_lib.zpp_rtos.mutex:
    tags:
      - kernel
      - cpp
    extra_conf_files: 
      - ../../../configs/prj.conf
      - ../../../configs/prj_test.conf
    extra_args: 
      - platform:qemu_x86/atom:CONFIG_SYS_CLOCK_TICKS_PER_SEC=5000
    
```

## zpp_rtos/tests/thread/testcase.yaml
```yaml
tests:
  zpp_lib.zpp_rtos.thread:
    tags:
      - kernel
      - cpp
    timeout: 120
    extra_conf_files: 
      - ../../../configs/prj.conf
      - ../../../configs/prj_log.conf
      - ../../../configs/prj_test.conf
    extra_args: 
      - platform:qemu_x86/atom:CONFIG_SYS_CLOCK_TICKS_PER_SEC=5000
      - platform:qemu_x86/atom:DTC_OVERLAY_FILE=../../../configs/boards/qemu_x86.overlay
      - platform:nrf5340dk/nrf5340/cpuapp:DTC_OVERLAY_FILE=../../../configs/boards/nrf5340dk_nrf5340_cpuapp.overlay
      - platform:native_sim:DTC_OVERLAY_FILE=../../../configs/boards/native_sim.overlay
    
```
